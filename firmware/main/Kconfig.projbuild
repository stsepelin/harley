## firmware/main/Kconfig.projbuild
```kconfig
menu "V-Rod cluster"

    config VROD_INCLUDE_SIM_ENGINE
        bool "Compile in the synthetic driving-cycle simulator"
        default y
        help
            When enabled, the cluster firmware includes sim_engine — a
            32-second synthetic driving cycle that feeds vehicle_data
            with looping speed / RPM / gear / fuel updates. Useful on
            the bench (the gauge dial visibly swings during boot tests
            and notification work) and required while real bike data
            sources (J1850, etc.) are still on the supply chain.

            Disable for real-bike builds — once Phase 3 lands, the
            J1850 driver becomes the vehicle_data producer and the
            sim is just dead weight in flash. Disabling here only
            affects the cluster firmware; the desktop SDL2 simulator
            in firmware/simulator/ always builds the sim because it
            has no other data source.

            Default y while the bike harness is still pending.

    config VROD_ADC_REPRO
        bool "esp_adc boot-crash repro instrumentation"
        default n
        help
            Boot-margin regression canary. Forces esp_adc (and its
            global constructor) into the link, probes heap integrity
            before it runs, and dumps per-heap state + every block if
            an allocation fails. The bug it was built for is fixed
            (pre-scheduler heap margin on rev<v3 silicon — see the
            addendum in docs/ble-bringup-bisect.md), but re-run this
            after IDF/toolchain bumps or when adding boot-time
            components. Use with sdkconfig.adc-repro in a separate
            build dir. Never enable in a real build.

    config VROD_PIN_WIGGLE_GPIO
        int "Bench pin-wiggle test GPIO (-1 = off)"
        range -1 54
        default -1
        help
            Toggles the chosen GPIO between 0V and 3.3V every 2.5 s and
            logs each transition, so a 40-pin-header hole can be matched
            to a GPIO number with a DMM instead of by counting
            silkscreen positions (see firmware/docs/PINS.md for the
            header map and the pins that must never be probed hot).
            -1 compiles the tool out entirely. Bench only — never leave
            enabled in a bike build.

    config VROD_GPS_UART
        bool "Read a NEO-6M/M8N GPS module on a UART"
        default n
        help
            Starts the NMEA reader task: RMC sentences from the module are
            parsed and published into gps_source, which the map view prefers
            over the phone GPS (freshest/lowest-latency wins). Position only --
            no POI/speed-camera or direction features. Off by default until the
            module is physically wired to the 40-pin header.

    config VROD_GPS_UART_NUM
        int "UART number for the GPS module"
        depends on VROD_GPS_UART
        range 1 4
        default 1
        help
            UART0 carries the console; pick any other. The GPIO matrix routes
            any UART to any pin, so the number itself hardly matters.

    config VROD_GPS_RX_GPIO
        int "GPIO wired to the module's TX pin"
        depends on VROD_GPS_UART
        default 21
        help
            Set to whatever header pin you actually soldered/jumpered.

    config VROD_GPS_TX_GPIO
        int "GPIO wired to the module's RX pin (-1 if not wired)"
        depends on VROD_GPS_UART
        default -1
        help
            Only needed to push UBX config (fix rate, constellations) to the
            module. Receiving fixes works with RX alone.

    config VROD_GPS_BAUD
        int "GPS module baud rate"
        depends on VROD_GPS_UART
        default 9600
        help
            Factory default for both NEO-6M and NEO-M8N is 9600.

    config VROD_J1850_SNIFFER
        bool "J1850 passive sniffer (Phase 3 Stage 2 capture build)"
        default n
        help
            Logs every J1850 VPW frame seen on the RX GPIO over serial:
            hex bytes + CRC verdict + any in-frame response, plus a
            10-second stats line (frames / bad CRC / pulse overruns).
            Strictly read-only — this build has no TX path, so it
            cannot disturb the bus or the stock cluster.

            Capture with:  script -q capture.log idf.py -p PORT monitor
            Off by default; only the bench capture build sets it.

    config VROD_J1850
        bool "J1850 vehicle-data producer (Phase 3 Stage 3)"
        depends on VROD_J1850_SNIFFER
        default n
        help
            Turns the sniffer's decode path into the vehicle_data producer:
            each recognised frame (RPM / temp / gear / speed / turns / CEL)
            is parsed and pushed to the gauge via vehicle_data_set. Built on
            the sniffer (which supplies the RX decode), so enable that too.

            Mutually exclusive with the synthetic sim: when this is on,
            sim_engine is not started (both write vehicle_data). Off by
            default; this is the real-bike data source.

    config VROD_J1850_BENCH_SPEED
        bool "Bench: inject a synthetic SPEED/RPM frame (no live bus)"
        depends on VROD_J1850
        default n
        help
            Desk-bench validation without a J1850 bus: a low-rate task feeds
            the producer a fixed SPEED frame (raw 19500) plus an RPM frame,
            straight through j1850_driver_feed, so speed_raw / speed_mph / rpm
            are non-zero on the gauge and in the phone telemetry stream. Lets
            the companion telemetry + config write-back (speed divisor) be
            exercised end to end before a ride - set a divisor and watch
            speed_mph = raw / divisor recompute. Bench only; never on a bike
            (it fabricates vehicle data).

    config VROD_RESET_CALIBRATION
        bool "Recovery: reset speed divisor to default on boot"
        depends on VROD_J1850
        default n
        help
            One-shot recovery: on boot, overwrite the NVS speed_divisor with
            SETTINGS_SPEED_DIVISOR_DEFAULT (logging the previous value first).
            Clears a stale calibration - e.g. a bench-test divisor left in NVS -
            WITHOUT erasing the odometer or BLE bonds (a full NVS erase would).
            Flash once with this on, confirm the log, then flash a clean build.

    config VROD_RIDE_LOG
        bool "On-board ride log to microSD (laptop-free capture)"
        depends on VROD_J1850_SNIFFER
        default n
        help
            Persists every decoded J1850 frame to /sdcard/ride_NNN.log so a
            speed / temperature / gear capture can run with NO laptop
            attached. Start and stop from the bench screen; power off, pull
            the microSD card, and run tools/j1850_report.py on the file (the
            line format is capture.py-compatible).

            Writes are buffered and flushed in a low-priority task, off the
            decode path and off the LVGL core. Storage faults (no card, card
            full, write error) stop logging cleanly and surface on the bench
            indicator without disturbing the gauge. Uses the board's microSD
            slot (GPIO 39-45); needs bike power to ride (see the Phase 3
            plan's ride-log prerequisite). Off by default.

    config VROD_RIDE_LOG_DUMP
        bool "Dump ride logs to the console at boot (serial retrieval)"
        depends on VROD_RIDE_LOG
        default n
        help
            Retrieval helper: on boot, after the microSD mounts, print every
            /sdcard/ride_NNN.log to the UART console wrapped in
            "===RIDELOG BEGIN <name> <bytes>===" / "===RIDELOG END <name>==="
            markers (all other console logging is silenced and CR/LF expansion
            disabled for the duration so the stream is byte-exact). Lets the
            logs be pulled over serial without removing the card;
            tools/ride_log_pull.py reconstructs the files from a capture.
            Bench / retrieval only - never enable in a real build.

    config VROD_J1850_RX_GPIO
        int "GPIO wired to the J1850 RX divider"
        depends on VROD_J1850_SNIFFER
        default 20
        help
            The 10k/4.7k divider node (bus 7V → ~2.2V). Set to the
            header pin you actually wired.

    config VROD_J1850_ADC_GPIO
        int "Bus-amplitude ADC probe GPIO (-1 = off)"
        depends on VROD_J1850_SNIFFER
        range -1 54
        default -1
        help
            Stage 4 TX-prep diagnostic. Reads node B (the RX divider
            output) via the ADC on a DEDICATED GPIO — run a second wire
            from node B to this header pin. Must NOT be the sniffer pin
            (VROD_J1850_RX_GPIO / GPIO 20): that pin can't be time-shared
            between the digital edge ISR + glitch filter and the ADC (the
            analog read comes back garbage). Use GPIO 22 (ADC1 ch6, free
            on the header). Logs bus idle/low levels every 2 s; the idle
            (max) reading is the resting-HIGH voltage the TX driver must
            overcome. -1 compiles the probe out. Bench diagnostic only.

    config VROD_J1850_GLITCH_NS
        int "RX glitch-filter window (ns, 0 = filter off)"
        depends on VROD_J1850_SNIFFER
        range 0 1600
        default 0
        help
            Hardware flex glitch-filter window on the RX pin: a pulse
            narrower than this is discarded before it reaches the
            interrupt matrix. Clocked from the 40 MHz XTAL, so the
            window is quantised to 25 ns steps and the P4's 64-tick
            field caps it at 1600 ns — the hardware CANNOT do the
            1-5 us some notes imagined.

            Default 0 (off), and this is settled, not provisional. The
            on-bike glitch-window sweep decoded ZERO frames at every
            nonzero window (400/800/1200/1600 ns alike) while 0 ns gave
            546 frames / 0 bad CRC — a hard cliff, not a gradient. Cause:
            the flex filter delays the filtered edge relative to the
            sniffer ISR's gpio_get_level() read, so the level recorded
            for the just-ended pulse is systematically wrong and frames
            never assemble. The delay amount barely matters, so no window
            is usable. (This same edge/level desync, not any real bus
            inversion, is what the removed RX_INVERT flag was masking.)

            Noise immunity for the permanent harness is therefore
            deferred to an RX hysteresis (comparator / Schmitt) front end
            in Phase 6 — see the master plan Phase 6 note. A software
            alternative that could let a conservative filter coexist is
            designed in firmware/docs/j1850-toggling-isr-candidate.md
            (infer the level by toggling instead of reading the pin). Use
            VROD_J1850_GLITCH_SWEEP to re-measure if the front end
            changes.

    config VROD_J1850_GLITCH_SWEEP
        bool "Auto-sweep the RX glitch window (bench diagnostic)"
        depends on VROD_J1850_SNIFFER
        default n
        help
            Temporary hands-free bench tool. Ignores VROD_J1850_GLITCH_NS
            and instead cycles the window through 0 / 400 / 800 / 1200 /
            1600 ns (1600 = the XTAL-clocked hardware ceiling), dwelling
            ~9 s each and resetting all counters at every change, then
            loops. Prints a labeled block per window:

              filter=<Xns> [pass K]: frames=.. badCRC=.. ovr=.. same-level=..

            so a single engine start compares every window across both
            idle and a throttle blip. The BENCH screen shows the current
            window + seconds remaining so you know when to blip mid-window
            (not on a boundary). Tracks the largest window that stayed
            clean (same-level=0 AND badCRC=0) across ALL passes. Never
            enable in a real build.

    config VROD_J1850_TOGGLE_ISR
        bool "Compile the toggling edge->level tracker (gate a; unused until the trial)"
        depends on VROD_J1850_SNIFFER
        default n
        help
            Gate (a) of two. Compiles main/j1850/j1850_edge.c (the
            host-tested toggle + idle-anchor RX level reconstructor) into
            the firmware so it is available for the Phase 6 on-hardware
            trial.

            HARMLESS ON ITS OWN: the live sniffer ISR still reads the pin
            and is completely unaffected — this flag only puts the module
            in the binary, nothing calls it. RX behaviour is byte-for-
            behaviour identical to this flag being off.

            Switching the live ISR to the tracker is the SEPARATE gate (b)
            below (VROD_J1850_TOGGLE_ISR_LIVE), which is deliberately not
            wired yet. See docs/j1850-toggling-isr-candidate.md.

    config VROD_J1850_TOGGLE_ISR_LIVE
        bool "Switch the live RX ISR to toggling (gate b; Phase 6 trial - NOT WIRED)"
        depends on VROD_J1850_TOGGLE_ISR
        default n
        help
            Gate (b) of two: the on-hardware experiment that would replace
            the sniffer ISR's pin read with j1850_edge's toggle +
            idle-anchor reconstruction, so a conservative glitch filter can
            coexist without the filter-vs-pin-read race.

            NOT YET FUNCTIONAL. Enabling this today has NO effect — the
            sniffer ISR is intentionally left unchanged in this merge. The
            wiring lands in Phase 6 and must be validated on the bench
            against the filter-off baseline (546 frames / 0 bad CRC), one
            variable at a time (toggle ISR + a conservative filter, invert
            nothing). Kept here so the two-step opt-in is explicit; see
            docs/j1850-toggling-isr-candidate.md.

    config VROD_J1850_TX
        bool "J1850 VPW transmitter (Phase 3 Stage 4)"
        default n
        help
            Compiles the TX driver: RMT-timed VPW symbols from the
            host-tested j1850_vpw.c encoder, driving the high-side
            transceiver (standard VPW, TX GPIO HIGH = bus dominant). An
            independent gptimer watchdog forces the line recessive (LOW)
            if a dominant persists past the longest valid symbol — a
            stuck-HIGH TX jams the whole bus. Off by default; only Stage 4
            builds set it. Physically wire the TX transistor stage
            (docs/schematics/j1850_tx.svg) only after the self-sniff loop
            below validates the firmware.

    config VROD_J1850_TX_GPIO
        int "GPIO driving the TX transceiver (Q1 gate via R3)"
        depends on VROD_J1850_TX
        range 0 54
        default 24
        help
            A free header pin (see firmware/docs/PINS.md — 24 is the first
            unclaimed one, clear of RX/ADC). Confirm the physical hole
            with VROD_PIN_WIGGLE_GPIO before soldering. Boots and idles LOW
            (recessive); only driven HIGH while emitting a dominant symbol.

    config VROD_J1850_TX_SELFTEST
        bool "TX self-sniff bench validation loop"
        depends on VROD_J1850_TX && VROD_J1850_SNIFFER
        default n
        help
            Bench gate before the bike: emits the IM keep-alive set on TX,
            the unchanged RX sniffer decodes it off the same bus node, and
            each frame is logged PASS/FAIL with the decoded bytes + CRC
            verdict. Needs the TX output tied to the RX bus node with the
            bench recessive-LOW termination (see the Stage 4 section of
            docs/03-PHASE3-J1850-PLAN.md). Bench only.

    config VROD_BLE_INSECURE
        bool "Skip BLE pairing — any central can connect"
        default n
        help
            Disables the LE Secure Connections pairing + bonding flow
            and lets any nearby central read / write the cluster's
            characteristics without authentication.

            DO NOT enable on a bike. Only useful for bench work where
            re-pairing every flash cycle is annoying — e.g. iterating
            on the notification banner via tools/notify.py while
            verifying the on-device render path.

            When n (the default): the cluster requires LE Secure
            Connections numeric-comparison pairing on first connect,
            shows the 6-digit passkey on the settings screen for the
            rider to confirm, and stores the bond in NVS so subsequent
            connects are silent.

    config VROD_MAP_DEMO
        bool "Bench demo: synthetic gauge + vector map"
        default n
        select VROD_INCLUDE_SIM_ENGINE
        help
            One flag for the whole bench demo (no bike, no phone needed). It
            chains both demos:

              - forces the synthetic driving-cycle gauge to run (even in a
                J1850 build), so the gauge and the map's instrument strip show
                live-looking speed / RPM / gear;
              - registers the compact vector-map screen from an embedded
                Tallinn route + tiles (tools/maptiles).

            Boots to the gauge; double-tap toggles to the map. When a phone
            streams GPS the map follows real position, else it plays the baked
            route.

            OFF in production: the entire map module and the embedded tiles are
            compiled out (no baked-route fallback ships). The real SD-backed map
            is CONFIG_VROD_MAP_SD.

    config VROD_MAP_SD
        bool "Real map: vector tiles from microSD"
        default n
        help
            Ship the moving map for real: mount the microSD, load a packed ZMTA
            archive (tools/maptiles/pack.py) from CONFIG_VROD_MAP_SD_PATH into
            PSRAM, and scroll it from live phone GPS + bus data - no synthetic
            route. A city/region archive is small enough (roads + water at z16 =
            hundreds of KB to a few MB) to keep off flash and on the card.

            Boots to the gauge; double-tap toggles to the map. No-op if the card
            or archive is missing. Independent of CONFIG_VROD_MAP_DEMO (that one
            embeds a demo route in flash); enabling both is pointless but safe.

    config VROD_MAP_SD_PATH
        string "microSD path to the ZMTA map archive"
        depends on VROD_MAP_SD && !VROD_MAP_SD_CELLS
        default "/sdcard/map.zmta"

    config VROD_MAP_SD_CELLS
        bool "Paged cell grid (whole continent) instead of one archive"
        depends on VROD_MAP_SD
        default n
        help
            Page a GPS-driven grid of per-cell ZMTA archives off the card
            instead of loading a single region archive. world.hdr + one
            <lat>/<lon>.zmt per cell (tools/maptiles/world.py) let a whole
            continent live on the card while only the cells near the rider stay
            resident - the index that would be gigabytes for Europe is paged by
            position. See firmware/docs/map-worldwide-plan.md.

            OFF: the single-archive path (CONFIG_VROD_MAP_SD_PATH), unchanged.

    config VROD_MAP_SD_DIR
        string "microSD directory of the paged cell map"
        depends on VROD_MAP_SD_CELLS
        default "/sdcard/map"

endmenu
```
