## firmware/sdkconfig.defaults
```kconfig
# Target
CONFIG_IDF_TARGET="esp32p4"
CONFIG_ESP32P4_SELECTS_REV_LESS_V3=y
CONFIG_ESP32P4_REV_MIN_1=y

# Flash
CONFIG_ESPTOOLPY_FLASHMODE_QIO=y
CONFIG_ESPTOOLPY_FLASHSIZE_16MB=y

# Partitions
CONFIG_PARTITION_TABLE_CUSTOM=y

# PSRAM + L2 cache (needed for 800x800 framebuffer + LVGL working memory)
CONFIG_SPIRAM=y
CONFIG_SPIRAM_SPEED_200M=y
CONFIG_SPIRAM_XIP_FROM_PSRAM=y
CONFIG_CACHE_L2_CACHE_256KB=y
CONFIG_CACHE_L2_CACHE_LINE_128B=y

# Compiler / runtime
CONFIG_COMPILER_OPTIMIZATION_PERF=y
CONFIG_ESP_MAIN_TASK_STACK_SIZE=10240
CONFIG_FREERTOS_HZ=1000

# LVGL
CONFIG_LV_USE_CLIB_MALLOC=y
CONFIG_LV_USE_CLIB_STRING=y
CONFIG_LV_USE_CLIB_SPRINTF=y
CONFIG_LV_DEF_REFR_PERIOD=15
CONFIG_LV_OS_FREERTOS=y
CONFIG_LV_DRAW_SW_DRAW_UNIT_CNT=2

# Boot animation: GIF (LZW + bitmap blit — cheap on the P4). Vector / Lottie
# was dropped because ThorVG rasterization at 800×800 wasn't real-time on
# this MCU. The bundled AnimatedGIF decoder caps width at 480 px by default;
# we patch MAX_WIDTH up to 800 to match the panel width.
CONFIG_LV_USE_GIF=y

# PPA hardware accelerator was tried for the cooked-GIF blit but causes
# horizontal banding on this BSP's DSI tear-avoid triple-buffer setup, so
# it's off. Re-enable only with a known-good buffer alignment story.
# CONFIG_LV_USE_PPA is not set

# Pin pthreads to core 1 so any LVGL draw worker stays off the sim core.
CONFIG_PTHREAD_DEFAULT_CORE_1=y
CONFIG_PTHREAD_TASK_CORE_DEFAULT=1
# IRAM-placement of LVGL fast-mem functions is replaced by a stable section
# override in main/CMakeLists.txt (GCC 15 rejects IRAM_ATTR's __COUNTER__).
# CONFIG_LV_ATTRIBUTE_FAST_MEM_USE_IRAM is not set

# All UI text uses JetBrains Mono Bold compiled in as custom .c files
# (see main/display/fonts). Only Montserrat 14 stays enabled because
# LVGL's Kconfig forces SOME built-in font as the default — the bigger
# Montserrat sizes used to be there for the boot-screen text fallback,
# which now reuses JBM Bold.
CONFIG_LV_FONT_MONTSERRAT_14=y

# FreeType runtime font rendering — used for color emoji. The lv_font_conv
# pipeline can only bake single-color bitmaps, so emoji land here as a
# runtime fallback (lv_font_t.fallback chain). FT_DISABLE_PNG is on in
# the espressif freetype port, which rules out NotoColorEmoji's sbix
# format — we ship Noto-COLRv1 (vector COLR/CPAL) instead.
#
# LV_USE_FS_MEMFS lets us hand the FreeType create_font path an in-memory
# buffer wrapped in lv_fs_path_ex_t instead of a real filesystem path —
# the TTF is embedded via EMBED_FILES so it lives in flash, not on SD.
# 'M' = 0x4D is the drive letter the docs suggest.
CONFIG_LV_USE_FREETYPE=y
CONFIG_LV_FREETYPE_USE_LVGL_PORT=y
CONFIG_ESP_LVGL_ADAPTER_ENABLE_FREETYPE=y
CONFIG_LV_USE_FS_MEMFS=y
CONFIG_LV_FS_MEMFS_LETTER=77
# FreeType's COLR rasterizer is stack-hungry — LVGL refuses to compile
# unless the draw-thread stack is at least 32 KB.
CONFIG_LV_DRAW_THREAD_STACK_SIZE=32768
# Glyph cache ceiling. Default (256) would let the emoji cache balloon to
# ~700 KB PSRAM with ARGB8888 32×32 glyphs. Realistic working set on the
# cluster is <30 distinct emoji at a time; cap to 64 so the cache stays
# under ~170 KB and evicts long-tail glyphs sooner.
CONFIG_LV_FREETYPE_CACHE_FT_GLYPH_CNT=64

# IDF v6 experimental features (BSP needs DSI etc.)
CONFIG_IDF_EXPERIMENTAL_FEATURES=y

# --- BLE peripheral via esp_hosted VHCI on co-proc ESP32-C6 ---
# The cluster has no native BT controller; the ESP32-C6 module on the
# Waveshare board acts as the BLE coprocessor and we host the NimBLE host
# stack here, talking to it over SDIO (esp_hosted) using the VHCI transport.
CONFIG_BT_ENABLED=y
CONFIG_BT_NIMBLE_ENABLED=y
CONFIG_BT_BLUEDROID_ENABLED=n
CONFIG_BT_NIMBLE_ROLE_BROADCASTER=y
CONFIG_BT_NIMBLE_ROLE_PERIPHERAL=y
# CONFIG_BT_NIMBLE_ROLE_CENTRAL is not set
# CONFIG_BT_NIMBLE_ROLE_OBSERVER is not set
CONFIG_BT_NIMBLE_MAX_CONNECTIONS=1
CONFIG_BT_NIMBLE_NVS_PERSIST=y
# CONFIG_BT_NIMBLE_TRANSPORT_UART is not set
CONFIG_ESP_HOSTED_ENABLED=y
CONFIG_ESP_HOSTED_ENABLE_BT_NIMBLE=y

# Drop the vendor-specific spi_flash chip-driver registration so
# winbond / mxic / issi / boya / th don't compete with the generic driver
# for IRAM placement on P4 < v3 silicon under
# -Wl,--enable-non-contiguous-regions. main.c provides the cut-down
# default_registered_chips[] containing just the generic driver.
# See docs/ble-bringup-bisect.md for the full story.
CONFIG_SPI_FLASH_OVERRIDE_CHIP_DRIVER_LIST=y
```

## sdkconfig.defaults
```kconfig
# Target
CONFIG_IDF_TARGET="esp32p4"
CONFIG_ESP32P4_SELECTS_REV_LESS_V3=y
CONFIG_ESP32P4_REV_MIN_1=y

# Flash
CONFIG_ESPTOOLPY_FLASHMODE_QIO=y
CONFIG_ESPTOOLPY_FLASHSIZE_16MB=y

# Partitions
CONFIG_PARTITION_TABLE_CUSTOM=y

# PSRAM + L2 cache (needed for 800x800 framebuffer + LVGL working memory)
CONFIG_SPIRAM=y
CONFIG_SPIRAM_SPEED_200M=y
CONFIG_SPIRAM_XIP_FROM_PSRAM=y
CONFIG_CACHE_L2_CACHE_256KB=y
CONFIG_CACHE_L2_CACHE_LINE_128B=y

# Compiler / runtime
CONFIG_COMPILER_OPTIMIZATION_PERF=y
CONFIG_ESP_MAIN_TASK_STACK_SIZE=10240
CONFIG_FREERTOS_HZ=1000

# LVGL
CONFIG_LV_USE_CLIB_MALLOC=y
CONFIG_LV_USE_CLIB_STRING=y
CONFIG_LV_USE_CLIB_SPRINTF=y
CONFIG_LV_DEF_REFR_PERIOD=15
CONFIG_LV_OS_FREERTOS=y
CONFIG_LV_DRAW_SW_DRAW_UNIT_CNT=2

# Boot animation: GIF (LZW + bitmap blit — cheap on the P4). Vector / Lottie
# was dropped because ThorVG rasterization at 800×800 wasn't real-time on
# this MCU. The bundled AnimatedGIF decoder caps width at 480 px by default;
# we patch MAX_WIDTH up to 1024 so the boot GIF can run at native panel size
# with zero LVGL scaling.
CONFIG_LV_USE_GIF=y

# PPA hardware accelerator was tried for the cooked-GIF blit but causes
# horizontal banding on this BSP's DSI tear-avoid triple-buffer setup, so
# it's off. Re-enable only with a known-good buffer alignment story.
# CONFIG_LV_USE_PPA is not set

# Pin pthreads to core 1 so any LVGL draw worker stays off the sim core.
CONFIG_PTHREAD_DEFAULT_CORE_1=y
CONFIG_PTHREAD_TASK_CORE_DEFAULT=1
# IRAM-placement of LVGL fast-mem functions is replaced by a stable section
# override in main/CMakeLists.txt (GCC 15 rejects IRAM_ATTR's __COUNTER__).
# CONFIG_LV_ATTRIBUTE_FAST_MEM_USE_IRAM is not set

# Boot screen uses Montserrat (22 + 48); the live gauge UI uses JetBrains
# Mono Bold compiled in as custom .c files (see main/display/fonts).
CONFIG_LV_FONT_MONTSERRAT_22=y
CONFIG_LV_FONT_MONTSERRAT_48=y

# IDF v6 experimental features (BSP needs DSI etc.)
CONFIG_IDF_EXPERIMENTAL_FEATURES=y
```
